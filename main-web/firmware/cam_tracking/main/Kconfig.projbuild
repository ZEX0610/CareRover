## main-web/firmware/cam_tracking/main/Kconfig.projbuild
```kconfig
menu "CareRover CAM"
config CAREROVER_TUNING_PROFILE
    int "Tuning profile: 0 safe, 1 balanced, 2 diagnostic"
    range 0 2
    default 0
config CAREROVER_FACE
    bool "Enable face detection"
    default y
config CAREROVER_VIDEO
    bool "Enable wireless MJPEG"
    default y
config CAREROVER_PICO_FACE
    bool "Use Pico 224 instead of MSR/MNP"
    default n
config CAREROVER_WIFI_SSID
    string "Main controller AP SSID"
    default "CareRover-XXXX"
config CAREROVER_WIFI_PASSWORD
    string "Main controller AP password"
    default "COMPILE_CHECK_ONLY"
endmenu
```

## main-web/firmware/cam_tracking/sdkconfig.defaults
```kconfig
CONFIG_IDF_TARGET="esp32s3"
CONFIG_ESPTOOLPY_FLASHMODE_DIO=y
CONFIG_ESPTOOLPY_FLASHFREQ_80M=y
CONFIG_ESPTOOLPY_FLASHSIZE_8MB=y
CONFIG_PARTITION_TABLE_CUSTOM=y
CONFIG_PARTITION_TABLE_CUSTOM_FILENAME="partitions.csv"
CONFIG_COMPILER_OPTIMIZATION_PERF=y
CONFIG_SPIRAM=y
CONFIG_SPIRAM_MODE_OCT=y
CONFIG_SPIRAM_SPEED_80M=y
CONFIG_SPIRAM_XIP_FROM_PSRAM=y
CONFIG_ESP_DEFAULT_CPU_FREQ_MHZ_240=y
CONFIG_ESP32S3_INSTRUCTION_CACHE_32KB=y
CONFIG_ESP32S3_DATA_CACHE_64KB=y
CONFIG_ESP32S3_DATA_CACHE_LINE_64B=y
CONFIG_ESP_CONSOLE_UART_DEFAULT=y
CONFIG_ESP_CONSOLE_UART_BAUDRATE=115200
CONFIG_FLASH_ESPDET_PICO_224_224_HAND=y
CONFIG_HAND_DETECT_MODEL_IN_FLASH_RODATA=y
CONFIG_FLASH_HAND_GESTURE_CLS_MOBILENETV2_0_5_S8_V1=y
CONFIG_HAND_GESTURE_CLS_MODEL_IN_FLASH_RODATA=y

CONFIG_FLASH_HUMAN_FACE_DETECT_MSRMNP_S8_V1=y
CONFIG_HUMAN_FACE_DETECT_MODEL_IN_FLASH_RODATA=y
CONFIG_HTTPD_MAX_REQ_HDR_LEN=1024
```
